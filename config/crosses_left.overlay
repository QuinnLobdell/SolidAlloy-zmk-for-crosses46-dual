&trackball_peripheral {
    cpi = <200>;
    y-invert;
	/delete-property/ x-invert;
};

&trackball_peripheral_split {
	status = "disabled";
    device = <&trackball_peripheral>;
    input-processors = <&zip_ble_report_rate_limit>;
};

&trackball_peripheral {
	status = "disabled";
};